// Definitions for w1-gpio module (with external pullup)
/dts-v1/;
/plugin/;

/ {
	compatible = "brcm,bcm2835";

	fragment@0 {
		target = <&gpio>;
		__overlay__ {
			moco_out_pins: moco_out_pins {
				brcm,pins =     < 4 17 18 22 23 24 25 27>;
				brcm,function = < 1  1  1  1  1  1  1  1>; // out
				brcm,pull =     < 0  0  0  0  0  0  0  0>; // pull off off
			};
		};
	};
	fragment@1 {
		target = <&gpio>;
		__overlay__ {
			moco_in_pins: moco_in_pins {
				brcm,pins =     < 5  6 12 13 16 19 20 21>;
				brcm,function = < 0  0  0  0  0  0  0  0>; // in
				brcm,pull =     < 2  2  2  2  2  2  2  2>; // pull-up
			};
		};
	};
};
