## conf/layer.conf
```bitbake
# We have a conf and classes directory, add to BBPATH
BBPATH .= ":${LAYERDIR}"

# We have recipes-* directories, add to BBFILES
BBFILES += "${LAYERDIR}/recipes-*/*/*.bb \
            ${LAYERDIR}/recipes-*/*/*.bbappend"

BBFILE_COLLECTIONS += "sugrow"
BBFILE_PATTERN_sugrow = "^${LAYERDIR}/"
BBFILE_PRIORITY_sugrow = "10"

LAYERDEPENDS_sugrow = "core raspberrypi"
LAYERSERIES_COMPAT_sugrow = "warrior"
```
